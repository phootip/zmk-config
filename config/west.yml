## config/west.yml
```yaml
manifest:
  remotes:
    - name: zmkfirmware
      url-base: https://github.com/zmkfirmware
    - name: infused-kim
      url-base: https://github.com/infused-kim
  projects:
    - name: zmk
#       remote: zmkfirmware
      remote: infused-kim
      revision: phoo/right-encoder
      import: app/west.yml
  self:
    path: config
```
